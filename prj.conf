## CMakeLists.txt
```
# SPDX-License-Identifier: Apache-2.0

cmake_minimum_required(VERSION 3.20.0)

# Read version from VERSION file and inject into Kconfig
file(STRINGS "${CMAKE_CURRENT_SOURCE_DIR}/VERSION" ver_lines)
foreach(line ${ver_lines})
    if(line MATCHES "^VERSION_MAJOR = ([0-9]+)")
        set(VER_MAJOR ${CMAKE_MATCH_1})
    elseif(line MATCHES "^VERSION_MINOR = ([0-9]+)")
        set(VER_MINOR ${CMAKE_MATCH_1})
    elseif(line MATCHES "^PATCHLEVEL = ([0-9]+)")
        set(VER_PATCH ${CMAKE_MATCH_1})
    endif()
endforeach()

set(APP_VER "${VER_MAJOR}.${VER_MINOR}.${VER_PATCH}")
message(STATUS "App version: ${APP_VER}")

set(VERSION_CONF "${CMAKE_BINARY_DIR}/version.conf")
file(WRITE ${VERSION_CONF}
    "CONFIG_FIRMWARE_VERSION=\"${APP_VER}\"\n"
    "CONFIG_MCUBOOT_IMGTOOL_SIGN_VERSION=\"${APP_VER}+0\"\n"
)
list(APPEND OVERLAY_CONFIG "${VERSION_CONF}")

find_package(Zephyr REQUIRED HINTS $ENV{ZEPHYR_BASE})
project(blynk_https)

target_sources(app PRIVATE src/main.c)
target_sources(app PRIVATE src/cloud/cloud.c)
```

## Kconfig
```
mainmenu "Application Configuration"

config BLYNK_SERVER
    string "Blynk Server"

config BLYNK_AUTH_TOKEN
    string "Blynk Auth Token"

config BLYNK_TEMPLATE_ID
    string "Blynk Template ID (e.g. TMPLabcd1234)"

config FIRMWARE_VERSION
    string "Firmware version string"
    default "0.1.0"

config DEFAULT_DELAY
    int "Update interval (minutes)"
    default 1440

rsource "src/cloud/Kconfig"
source "Kconfig.zephyr"
```

## prj.conf
```kconfig
# Blynk MQTT
# CONFIG_BLYNK_SERVER="fra1.blynk.cloud"
# CONFIG_BLYNK_AUTH_TOKEN="<yourToken>"
CONFIG_BLYNK_SERVER="lon1.blynk.cloud"
CONFIG_BLYNK_AUTH_TOKEN="x4_SIJkM9WDh-dBq94fCX6f_fzKZRYkc"
CONFIG_BLYNK_TEMPLATE_ID="TMPL5YluS7bTY"

# How long between sends, in minutes
CONFIG_DEFAULT_DELAY=1

# Enable this to see modem AT commands for debugging
CONFIG_LTE_LINK_CONTROL_LOG_LEVEL_INF=y

# Heap and stacks – increased for MQTT + FOTA
CONFIG_HEAP_MEM_POOL_SIZE=32768
CONFIG_MAIN_STACK_SIZE=4096
CONFIG_SYSTEM_WORKQUEUE_STACK_SIZE=4096

# New Libc
CONFIG_NEWLIB_LIBC=y
CONFIG_NEWLIB_LIBC_FLOAT_PRINTF=y

# Network
CONFIG_NETWORKING=y
CONFIG_NET_NATIVE=n
CONFIG_NET_SOCKETS=y
CONFIG_NET_SOCKETS_OFFLOAD=y
CONFIG_POSIX_API=y
CONFIG_NET_IPV6=n
CONFIG_NET_IPV4=y

# LTE link control
CONFIG_LTE_LINK_CONTROL=y
CONFIG_LTE_NETWORK_MODE_LTE_M_GPS=y


# Modem library
CONFIG_NRF_MODEM_LIB=y
CONFIG_NRF_MODEM_LIB_TRACE=n
CONFIG_MODEM_KEY_MGMT=y

# Date Time library
CONFIG_DATE_TIME=y

# Reboot support (used by FOTA callback)
CONFIG_REBOOT=y

# Logging
CONFIG_LOG=y
# CONFIG_LOG_MODE_IMMEDIATE=y

# cJSON
CONFIG_CJSON_LIB=y

# MQTT (replaces HTTP)
CONFIG_MQTT_LIB=y
CONFIG_MQTT_LIB_TLS=y
CONFIG_MQTT_KEEPALIVE=30

# FOTA / OTA over MQTT
CONFIG_FOTA_DOWNLOAD=y
CONFIG_FOTA_DOWNLOAD_PROGRESS_EVT=y
CONFIG_DFU_TARGET=y
CONFIG_DFU_TARGET_MCUBOOT=y

CONFIG_BOOTLOADER_MCUBOOT=y
CONFIG_MCUBOOT_IMG_MANAGER=y

CONFIG_IMG_MANAGER=y
CONFIG_STREAM_FLASH=y
CONFIG_DOWNLOADER=y
CONFIG_DOWNLOADER_MAX_HOSTNAME_SIZE=64
CONFIG_DOWNLOADER_MAX_FILENAME_SIZE=192

# Flash required for FLASH_MAP -> MCUBOOT_IMG_MANAGER
CONFIG_FLASH=y
CONFIG_FLASH_MAP=y
# NS flash driver doesn't expose page layout; disable the inspect check
CONFIG_STREAM_FLASH_INSPECT=n
```

## src/main.c
```c
/*
 * Copyright (c) 2020 Circuit Dojo LLC
 *
 * SPDX-License-Identifier: Apache-2.0
 */

#include <zephyr/kernel.h>
#include <zephyr/pm/device.h>
#include <zephyr/logging/log.h>
LOG_MODULE_REGISTER(main);

/* nRF Libraries */
#include <modem/nrf_modem_lib.h>
#include <modem/lte_lc.h>
#include <modem/modem_info.h>

/* Local */
#include "cloud/cloud.h"
#include "credentials/credentials.h"

/* ── Blynk firmware binary tag ───────────────────────────────────────────── */

#define BLYNK_PARAM_KV(k, v)  k "\0" v "\0"

volatile const char firmwareTag[] __attribute__((used)) = "blnkinf\0"
	BLYNK_PARAM_KV("mcu"    , CONFIG_FIRMWARE_VERSION)
	BLYNK_PARAM_KV("fw-type", CONFIG_BLYNK_TEMPLATE_ID)
	BLYNK_PARAM_KV("build"  , __DATE__ " " __TIME__)
	BLYNK_PARAM_KV("blynk"  , "0.1.0")
	BLYNK_PARAM_KV("hw"     , CONFIG_BOARD)
	"\0";


/* Timer */
static void timeout_handler(struct k_timer *timer_id);
K_TIMER_DEFINE(timer, timeout_handler, NULL);

/* Thread control */
K_SEM_DEFINE(thread_sem, 0, 1);

/* Variables */
static struct device_data data = {
    .do_something = true,
};

void cloud_cb(struct device_data *p_data)
{
    LOG_INF("Cloud callback");

    /* TODO: handle data here */
}

static void timeout_handler(struct k_timer *timer_id)
{
    LOG_INF("Publish interval");
    k_sem_give(&thread_sem);
}

int main(void)
{
    int err;

    LOG_INF("Blynk MQTT Sample. Board: %s  FW: %s  Build: %s %s",
            CONFIG_BOARD, CONFIG_FIRMWARE_VERSION, __DATE__, __TIME__);
    (void)firmwareTag[0]; /* retain firmware tag in binary */

    /* Load credentials from NVS */
    err = credentials_init();
    if (err == -ENOENT)
    {
        /* No auth token – shell is still running, wait for provisioning */
        while (1) {
            k_sleep(K_FOREVER);
        }
    }
    else if (err < 0)
    {
        LOG_ERR("Failed to init credentials storage. (err: %i)", err);
        return err;
    }

    /* Init modem lib */
    err = nrf_modem_lib_init();
    if (err < 0)
    {
        LOG_ERR("Failed to init modem lib. (err: %i)", err);
        return err;
    }

    /* Cloud init */
    err = cloud_init(cloud_cb);
    if (err < 0)
    {
        LOG_ERR("Unable to set callback. Err: %i", err);
        return err;
    }

    /* Connect to cellular network */
    LOG_INF("Connecting to cellular network…");
    err = lte_lc_connect();
    if (err < 0)
    {
        LOG_ERR("Failed to connect. Err: %i", err);
        return err;
    }

    /* LTE is up – start MQTT and wait for first connection */
    cloud_start();
    cloud_wait_connected();

    /* Start timer and trigger immediate first publish */
    k_timer_start(&timer, K_MINUTES(CONFIG_DEFAULT_DELAY), K_MINUTES(CONFIG_DEFAULT_DELAY));
    k_sem_give(&thread_sem);

    while (1)
    {
        k_sem_take(&thread_sem, K_FOREVER);

        /* Publish and sleep .. */
        err = cloud_publish(&data);
        if (err < 0)
            LOG_ERR("Unable to publish. Err: %i", err);
    }
}
```
